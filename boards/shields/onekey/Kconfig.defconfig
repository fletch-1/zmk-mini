## boards/shields/onekey/Kconfig.defconfig
```kconfig
if SHIELD_ONE_KEY
            
config ZMK_KEYBOARD_NAME
    default "One Key"

endif
```

## config/boards/shields/onekey/Kconfig.defconfig
```kconfig
if SHIELD_ONEKEY
            
config ZMK_KEYBOARD_NAME
    default "One Key"

endif
```
