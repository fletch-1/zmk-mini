/ {
    chosen {
        zmk,kscan = &kscan0;
    };

    kscan0: kscan {
        compatible = "zmk,kscan-gpio-direct";
        wakeup-source;

        input-gpios
            = <&xiao_d 10 (GPIO_ACTIVE_LOW | GPIO_PULL_UP)>
            ;

    };

};
